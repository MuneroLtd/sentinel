## esp32-bridge/sdkconfig.defaults
```kconfig
# Sentinel Bridge — sdkconfig.defaults
# These values are applied at project configuration time and can be
# overridden in sdkconfig (generated by 'idf.py menuconfig').
# See ESP-IDF docs: https://docs.espressif.com/projects/esp-idf/en/v5.x/

# ---------------------------------------------------------------------------
# CPU & Clock
# ---------------------------------------------------------------------------
CONFIG_ESP_DEFAULT_CPU_FREQ_MHZ_240=y
# Ensure FreeRTOS tick rate is 1 kHz for <1 ms timeouts
CONFIG_FREERTOS_HZ=1000

# ---------------------------------------------------------------------------
# Flash
# ---------------------------------------------------------------------------
CONFIG_ESPTOOLPY_FLASHSIZE_4MB=y
# Use the 'single_app_large' partition table to maximise code partition space
CONFIG_PARTITION_TABLE_SINGLE_APP_LARGE=y

# ---------------------------------------------------------------------------
# Wi-Fi buffers (helps throughput when IQ streaming + web server active)
# ---------------------------------------------------------------------------
CONFIG_ESP_WIFI_STATIC_RX_BUFFER_NUM=10
CONFIG_ESP_WIFI_DYNAMIC_RX_BUFFER_NUM=32
# Allow Wi-Fi to stay connected during heavy Tx load
CONFIG_ESP_WIFI_TX_BUFFER_TYPE_DYNAMIC=y

# ---------------------------------------------------------------------------
# MQTT
# ---------------------------------------------------------------------------
# Buffer must accommodate the largest JSON payload (SYSTEM_STATUS ~200 B)
# plus MQTT fixed header overhead.  512 B is ample.
CONFIG_MQTT_BUFFER_SIZE=512

# ---------------------------------------------------------------------------
# LWIP / TCP
# ---------------------------------------------------------------------------
CONFIG_LWIP_TCP_MSS=1460
# Increase socket receive buffer for UDP IQ streaming
CONFIG_LWIP_TCP_RECVMBOX_SIZE=16
CONFIG_LWIP_UDP_RECVMBOX_SIZE=16

# ---------------------------------------------------------------------------
# Logging
# ---------------------------------------------------------------------------
# Default log level: INFO in production (change to DEBUG for development)
CONFIG_LOG_DEFAULT_LEVEL_INFO=y

# ---------------------------------------------------------------------------
# Task watchdog
# ---------------------------------------------------------------------------
# Enable TWDT so hung tasks are detected
CONFIG_ESP_TASK_WDT_EN=y
CONFIG_ESP_TASK_WDT_TIMEOUT_S=30

# ---------------------------------------------------------------------------
# NVS
# ---------------------------------------------------------------------------
# Enable NVS encryption if platform supports it (optional — comment out if not)
# CONFIG_NVS_ENCRYPTION=y

# ---------------------------------------------------------------------------
# SPI / DMA
# ---------------------------------------------------------------------------
# Allow SPI DMA transfers (required for IQ stream DMA buffers)
CONFIG_SPI_MASTER_IN_IRAM=y
CONFIG_SPI_SLAVE_IN_IRAM=y

# ---------------------------------------------------------------------------
# HTTP server
# ---------------------------------------------------------------------------
CONFIG_HTTPD_MAX_REQ_HDR_LEN=1024
CONFIG_HTTPD_MAX_URI_LEN=512
```
